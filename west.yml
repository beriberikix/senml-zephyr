## west.yml
```yaml
manifest:
  version: 1.2
  remotes:
    - name: origin
      url-base: https://github.com/beriberikix
  projects:
    - name: senml-codec
      repo-path: senml-zephyr
      revision: main
  self:
    path: senml-codec
```
